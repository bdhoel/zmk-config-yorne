## config/boards/shields/yorne/Kconfig.defconfig
```kconfig
# Copyright (c) 2024 Ridwan Abdullah
# SPDX-License-Identifier: MIT


if SHIELD_YORNE_LEFT

config ZMK_KEYBOARD_NAME
    default "Yorne"

config ZMK_SPLIT_ROLE_CENTRAL
    default y

endif

if SHIELD_YORNE_LEFT || SHIELD_YORNE_RIGHT

config ZMK_SPLIT
    default y

endif
```

## config/boards/shields/yorne/Kconfig.shield
```kconfig
# Copyright (c) 2024 Ridwan Abdullah
# SPDX-License-Identifier: MIT

config SHIELD_YORNE_LEFT
    def_bool $(shields_list_contains,yorne_left)

config SHIELD_YORNE_RIGHT
    def_bool $(shields_list_contains,yorne_right)
```
